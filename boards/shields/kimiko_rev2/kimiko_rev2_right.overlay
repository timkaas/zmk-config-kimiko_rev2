#include "kimiko_rev2.dtsi"

&default_transform { // The matrix transform for this board is 8 columns over because the left half is 8 columns wide according to the matrix.
    col-offset = <8>;
};

&kscan0 {
    col-gpios
        = <&pro_micro 10 GPIO_ACTIVE_HIGH> // Col 5 from PCB
        , <&pro_micro 16 GPIO_ACTIVE_HIGH> // Col 4 from PCB
        , <&pro_micro 14 GPIO_ACTIVE_HIGH> // Col 3 from PCB
        , <&pro_micro 15 GPIO_ACTIVE_HIGH> // Col 2 from PCB
        , <&pro_micro 18 GPIO_ACTIVE_HIGH> // Col 1 from PCB
        , <&pro_micro 19 GPIO_ACTIVE_HIGH> // Col 0 from PCB
        ;
};

&right_encoder {
    status = "okay";
};